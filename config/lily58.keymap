/*
 * Copyright (c) 2020 The ZMK Contributors
 *
 * SPDX-License-Identifier: MIT
 */

#include <behaviors.dtsi>
#include <dt-bindings/zmk/keys.h>
#include <dt-bindings/zmk/bt.h>
#include <dt-bindings/zmk/ext_power.h>
#include <dt-bindings/zmk/rgb.h>

// Layer indices follow the order in which layer nodes appear below:
// reordering the includes requires updating these numbers.
#define BASE       0
#define LOWER      1
#define RAISE      2
#define GAME       3
#define GAME_LOWER 4
#define GAME_RAISE 5
#define EXTERNAL   6

#include "home_row_mods.dtsi"
#include "default_layers.dtsi"
#include "gaming_layers.dtsi"
#include "external_layers.dtsi"

/ {

    conditional_layers {
        compatible = "zmk,conditional-layers";

        ext_from_default {
            if-layers = <LOWER RAISE>;
            then-layer = <EXTERNAL>;
        };

        ext_from_gaming {
            if-layers = <GAME_LOWER GAME_RAISE>;
            then-layer = <EXTERNAL>;
        };
    };

};
